## blinky_rtt_f411re_bmp/boards/arm/nucleo_f411re_bmp/board.yml
```yaml
board:
  name: nucleo_f411re_bmp
  full_name: Nucleo F411RE with BlackMagicProbe
  vendor: st
  socs:
    - name: stm32f411xe
```
